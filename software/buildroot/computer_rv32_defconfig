## software/buildroot/computer_rv32_defconfig
```kconfig
BR2_riscv=y
BR2_RISCV_32=y
BR2_RISCV_ISA_RVI=y
BR2_RISCV_ISA_RVM=y
BR2_RISCV_ISA_RVA=y
BR2_RISCV_ISA_RVC=n
BR2_RISCV_ABI_ILP32=y
BR2_TOOLCHAIN_BUILDROOT=y
BR2_TOOLCHAIN_BUILDROOT_MUSL=y
BR2_TOOLCHAIN_BUILDROOT_CXX=n
BR2_TARGET_GENERIC_HOSTNAME="computer-rv32"
BR2_TARGET_GENERIC_ISSUE="Local RV32IMA Linux"
BR2_ROOTFS_OVERLAY="$(BR2_EXTERNAL_COMPUTER_PATH)/overlay"
BR2_PACKAGE_BUSYBOX=y
BR2_TARGET_ROOTFS_CPIO=y
BR2_TARGET_ROOTFS_CPIO_GZIP=n
BR2_TARGET_ROOTFS_TAR=n
```
